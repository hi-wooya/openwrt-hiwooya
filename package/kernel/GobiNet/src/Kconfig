## package/kernel/GobiNet/src/Kconfig
```kconfig
config USB_GOBI_NET
	tristate "Gobi USB Net driver for Quectel module"
	help
	  Support Quectel module.

	  A modemmanager with support for GobiNet is recommended.
	  To compile this driver as a module, chose M here;the module will be calledGobiNet.
```
